## configs/kylin32_wpe_defconfig
```kconfig
BR2_arm=y
BR2_cortex_a7=y
BR2_ARM_FPU_NEON_VFPV4=y
BR2_CCACHE=y
BR2_CCACHE_DIR="$(TOPDIR)/.ccache-buildroot-$(BR2_ARCH)"
BR2_OPTIMIZE_2=y
BR2_TOOLCHAIN_BUILDROOT_GLIBC=y
BR2_KERNEL_HEADERS_4_1=y
BR2_TOOLCHAIN_BUILDROOT_CXX=y
BR2_PACKAGE_HOST_GDB=y
BR2_TARGET_OPTIMIZATION="-mtune=cortex-a53"
BR2_TARGET_GENERIC_CABUNDLE=y
BR2_ROOTFS_DEVICE_CREATION_DYNAMIC_EUDEV=y
BR2_TARGET_GENERIC_ROOT_PASSWD="root"
BR2_TARGET_GENERIC_GETTY_PORT="ttyS0"
BR2_SYSTEM_DHCP="eth0"
BR2_ROOTFS_POST_BUILD_SCRIPT="board/kylin/copy_configs.sh"
BR2_PACKAGE_BUSYBOX_CONFIG="board/kylin/busybox.config"
BR2_PACKAGE_ALSA_UTILS=y
BR2_PACKAGE_ALSA_UTILS_APLAY=y
BR2_PACKAGE_GSTREAMER1=y
BR2_PACKAGE_GST1_COMMON=y
BR2_PACKAGE_GST1_PLUGINS_BASE_PLUGIN_APP=y
BR2_PACKAGE_GST1_PLUGINS_BASE_PLUGIN_AUDIORATE=y
BR2_PACKAGE_GST1_PLUGINS_BASE_PLUGIN_VIDEOCONVERT=y
BR2_PACKAGE_GST1_PLUGINS_BASE_PLUGIN_GIO=y
BR2_PACKAGE_GST1_PLUGINS_BASE_PLUGIN_ALSA=y
BR2_PACKAGE_GST1_PLUGINS_BASE_PLUGIN_TREMOR=y
BR2_PACKAGE_GST1_PLUGINS_BASE_PLUGIN_OGG=y
BR2_PACKAGE_GST1_PLUGINS_BASE_PLUGIN_OPUS=y
BR2_PACKAGE_GST1_PLUGINS_BASE_PLUGIN_THEORA=y
BR2_PACKAGE_GST1_PLUGINS_BASE_PLUGIN_VORBIS=y
BR2_PACKAGE_GST1_PLUGINS_GOOD_PLUGIN_AUDIOFX=y
BR2_PACKAGE_GST1_PLUGINS_GOOD_PLUGIN_AUDIOPARSERS=y
BR2_PACKAGE_GST1_PLUGINS_GOOD_PLUGIN_AUTODETECT=y
BR2_PACKAGE_GST1_PLUGINS_GOOD_PLUGIN_DEINTERLACE=y
BR2_PACKAGE_GST1_PLUGINS_GOOD_PLUGIN_ICYDEMUX=y
BR2_PACKAGE_GST1_PLUGINS_GOOD_PLUGIN_ID3DEMUX=y
BR2_PACKAGE_GST1_PLUGINS_GOOD_PLUGIN_INTERLEAVE=y
BR2_PACKAGE_GST1_PLUGINS_GOOD_PLUGIN_RTP=y
BR2_PACKAGE_GST1_PLUGINS_GOOD_PLUGIN_RTSP=y
BR2_PACKAGE_GST1_PLUGINS_GOOD_PLUGIN_SOUPHTTPSRC=y
BR2_PACKAGE_GST1_PLUGINS_BAD_PLUGIN_ID3TAG=y
BR2_PACKAGE_GST1_PLUGINS_BAD_PLUGIN_MPEGDEMUX=y
BR2_PACKAGE_GST1_PLUGINS_BAD_PLUGIN_MPEGTSDEMUX=y
BR2_PACKAGE_GST1_PLUGINS_BAD_PLUGIN_VIDEOPARSERS=y
BR2_PACKAGE_GST1_PLUGINS_BAD_PLUGIN_DASH=y
BR2_PACKAGE_GST1_PLUGINS_BAD_PLUGIN_FAAD=y
BR2_PACKAGE_GST1_PLUGINS_BAD_PLUGIN_HLS=y
BR2_PACKAGE_GST1_PLUGINS_BAD_PLUGIN_SMOOTHSTREAMING=y
BR2_PACKAGE_GST1_PLUGINS_UGLY=y
BR2_PACKAGE_GST1_PLUGINS_UGLY_PLUGIN_MAD=y
BR2_PACKAGE_GST1_PLUGINS_UGLY_PLUGIN_MPG123=y
BR2_PACKAGE_FLEX=y
BR2_PACKAGE_LIBTOOL=y
BR2_PACKAGE_NINJA=y
BR2_PACKAGE_BITSTREAM_VERA=y
# BR2_PACKAGE_EUDEV_ENABLE_HWDB is not set
BR2_PACKAGE_KYLIN_HARDWARE=y
BR2_PACKAGE_KYLIN_KERNEL_4_1_35=y
BR2_PACKAGE_KYLIN_GST_OMX=y
BR2_PACKAGE_KYLIN_GST_RTKV1SINK=y
KYLIN_PLATFORM_LIB_INSTALL_BINARIES=y
BR2_PACKAGE_KYLIN_GRAPHICS=y
BR2_PACKAGE_KYLIN_WESTON=y
BR2_PACKAGE_KYLIN_WESTON_DRM=y
BR2_PACKAGE_KYLIN_WESTON_DEMO_CLIENTS=y
BR2_PACKAGE_WESTEROS=y
BR2_PACKAGE_WESTEROS_SIMPLESHELL=y
BR2_PACKAGE_WESTEROS_SIMPLEBUFFER=y
BR2_PACKAGE_WESTEROS_SOC=y
BR2_PACKAGE_UBOOT_TOOLS=y
BR2_PACKAGE_UBOOT_TOOLS_MKIMAGE=y
BR2_PACKAGE_UBOOT_TOOLS_MKENVIMAGE=y
BR2_PACKAGE_UBOOT_TOOLS_DUMPIMAGE=y
BR2_PACKAGE_USBMOUNT=y
BR2_PACKAGE_FDK_AAC=y
BR2_PACKAGE_LIBSNDFILE=y
BR2_PACKAGE_OPENSSL=y
BR2_PACKAGE_GRAPHITE2=y
BR2_PACKAGE_LIBMNG=y
BR2_PACKAGE_WEBP=y
BR2_PACKAGE_WEBP_DEMUX=y
BR2_PACKAGE_WPEWEBKIT=y
# BR2_PACKAGE_WPEWEBKIT_ENABLE_NATIVE_VIDEO is not set
BR2_PACKAGE_LIBPCIACCESS=y
BR2_PACKAGE_JSON_C=y
BR2_PACKAGE_C_ARES=y
BR2_PACKAGE_LIBCURL=y
BR2_PACKAGE_CPPSDK_DEBUG=y
BR2_PACKAGE_ORC=y
BR2_PACKAGE_ICU_USE_ICUDATA=y
BR2_PACKAGE_SHARED_MIME_INFO=y
BR2_PACKAGE_DROPBEAR=y
BR2_PACKAGE_GESFTPSERVER=y
BR2_PACKAGE_IPROUTE2=y
BR2_PACKAGE_IW=y
BR2_PACKAGE_WPA_SUPPLICANT=y
BR2_PACKAGE_WPA_SUPPLICANT_AP_SUPPORT=y
BR2_PACKAGE_WPA_SUPPLICANT_WIFI_DISPLAY=y
BR2_PACKAGE_WPA_SUPPLICANT_MESH_NETWORKING=y
BR2_PACKAGE_WPA_SUPPLICANT_AUTOSCAN=y
BR2_PACKAGE_WPA_SUPPLICANT_EAP=y
BR2_PACKAGE_WPA_SUPPLICANT_WPS=y
BR2_PACKAGE_WPA_SUPPLICANT_CLI=y
BR2_PACKAGE_WPA_SUPPLICANT_WPA_CLIENT_SO=y
BR2_PACKAGE_WPA_SUPPLICANT_PASSPHRASE=y
BR2_PACKAGE_WPA_SUPPLICANT_SSID="Here Be Dragons"
BR2_PACKAGE_WPA_SUPPLICANT_PSK="daenerys"
BR2_PACKAGE_WEBBRIDGE=y
BR2_PACKAGE_WEBBRIDGE_PLUGIN_TRACECONTROL=y
BR2_PACKAGE_WEBBRIDGE_PLUGIN_WEBPROXY=y
BR2_PACKAGE_WEBBRIDGE_PLUGIN_REMOTECONTROL=y
BR2_PACKAGE_WEBBRIDGE_PLUGIN_DEVICEINFO=y
BR2_PACKAGE_WEBBRIDGE_PLUGIN_LOCATIONSYNC=y
BR2_PACKAGE_WEBBRIDGE_PLUGIN_TIMESYNC=y
BR2_PACKAGE_WEBBRIDGE_PLUGIN_WEBKITBROWSER=y
BR2_PACKAGE_WEBBRIDGE_PLUGIN_WEBKITBROWSER_STARTURL="file:///www/index.html"
BR2_PACKAGE_WEBBRIDGE_PLUGIN_WEBKITBROWSER_USERAGENT="Mozilla/5.0 (Macintosh, Intel Mac OS X 10_11_4) AppleWebKit/602.1.28+ (KHTML, like Gecko) Version/9.1 Safari/601.5.17 WPE-Reference"
BR2_PACKAGE_WEBBRIDGE_PLUGIN_WEBKITBROWSER_MEMORYPRESSURE="databaseprocess:100m,networkprocess:100m,webprocess:400m,rpcprocess:100m"
BR2_PACKAGE_WEBBRIDGE_PLUGIN_WEBKITBROWSER_DISKCACHE="512m"
BR2_PACKAGE_WEBBRIDGE_PLUGIN_WEBKITBROWSER_XHRCACHE=y
BR2_PACKAGE_WEBBRIDGE_PLUGIN_YOUTUBE=y
BR2_PACKAGE_WEBBRIDGE_PLUGIN_DIALSERVER=y
BR2_PACKAGE_WEBBRIDGE_PLUGIN_WEBSERVER=y
BR2_TARGET_ROOTFS_EXT2=y
BR2_TARGET_ROOTFS_EXT2_4=y
```

## package/WPEFramework/Config.in
```kconfig
menuconfig BR2_PACKAGE_WPEFRAMEWORK
	bool "WPEFramework"

	help
	   Base WPE Framework
	   
menuconfig BR2_PACKAGE_WPEFRAMEWORK_WEBPROXY
	bool "WPEFramework-WebProxy"

	help
	   WPE Platform WebProxy plugin

menuconfig BR2_PACKAGE_WPEFRAMEWORK_MONITOR
	bool "WPEFramework-Monitor"

	help
	   WPE Platform Monitor plugin

menuconfig BR2_PACKAGE_WPEFRAMEWORK_SNAPSHOT
	bool "WPEFramework-Snapshot"

	help
	   WPE Platform Snapshot plugin

menuconfig BR2_PACKAGE_WPEFRAMEWORK_PROVISIONING
	bool "WPEFramework-Provisioning"
	select BR2_PACKAGE_LIBPROVISION
	help
	   WPE Platform Provisioning plugin

menuconfig BR2_PACKAGE_WPEFRAMEWORK_WEBKITBROWSER
	bool "WPEFramework-WebKitBrowser"

	help
	   WPE Platform WebKitBrowser plugin

menuconfig BR2_PACKAGE_WPEFRAMEWORK_DIALSERVER
	bool "WPEFramework-DIALServer"

	help
	   WPE Platform DIALServer plugin

menuconfig BR2_PACKAGE_WPEFRAMEWORK_DEVICEINFO
	bool "WPEFramework-DeviceInfo"

	help
	   WPE Platform DeviceInfo plugin

menuconfig BR2_PACKAGE_WPEFRAMEWORK_REMOTECONTROL
	bool "WPEFramework-RemoteControl"

	help
	   WPE Platform RemoteControl plugin

menuconfig BR2_PACKAGE_WPEFRAMEWORK_TRACECONTROL
	bool "WPEFramework-TraceControl"

	help
	   WPE Platform TraceControl plugin

menuconfig BR2_PACKAGE_WPEFRAMEWORK_NETFLIX
	bool "WPEFramework-Netflix"

	help
	   WPE Platform Netflix plugin

menuconfig BR2_PACKAGE_WPEFRAMEWORK_WEBSERVER
	bool "WPEFramework-WebServer"

	help
	   WPE Platform WebServer plugin
```
